## package/erpiam-main/Config.in
```kconfig
config BR2_PACKAGE_ERPIAM_MAIN
        bool "Erpiam Main"
        select BR2_ALSA_LIB
        select BR2_PACKAGE_FREETYPE
        select BR2_PACKAGE_LIBCURL
        select BR2_PACKAGE_XLIB_LIBEXT
        select BR2_PACKAGE_XLIB_LIBX11
        select BR2_PACKAGE_XLIB_LIBXCURSOR
        select BR2_PACKAGE_XLIB_LIBXINERAMA
        select BR2_PACKAGE_XLIB_LIBXRANDR
        depends on BR2_INSTALL_LIBSTDCPP
        depends on BR2_TOOLCHAIN_HAS_THREADS
        depends on BR2_TOOLCHAIN_USES_GLIBC
        help
          Erpiam blueprint main UI based on JUCE 
```

## package/erpiam/Config.in
```kconfig
config BR2_PACKAGE_ERPIAM
	bool "Erpiam"
	select BR2_PACKAGE_RPI_FIRMWARE
	help
	  Embedded Raspberry PI 3 Linux distribution for Audio and MIDI

if BR2_PACKAGE_ERPIAM

config BR2_PACKAGE_ERPIAM_X11_NOCURSOR
	bool "Hide X11 cursor"
	help
	  Hide the mouse cursor in X11

config BR2_PACKAGE_ERPIAM_CONFIG_DTOVERLAY
	string "Device tree overlays"
	help
	  Device tree overlays that will be added to config.xml

config BR2_PACKAGE_ERPIAM_CONFIG_DTPARAM
	string "Device tree params"
	help
	  Device tree parameters that will be added to config.xml

config BR2_PACKAGE_ERPIAM_BOOT_SPLASH
	string "Path to ASCII PPM splash image"
	default "package/erpiam/logo_linux_clut224.ppm"
	help
	  The path towards an ASCII PPM image that will be compiled into the
	  Linux kernel to use as a boot splash screen

endif # BR2_PACKAGE_ERPIAM
```

## package/otto-main/Config.in
```kconfig
config BR2_PACKAGE_OTTO_MAIN
        bool "Otto Main"
        select BR2_ALSA_LIB
        select BR2_PACKAGE_FREETYPE
        select BR2_PACKAGE_LIBCURL
        select BR2_PACKAGE_RPI_FIRMWARE
        select BR2_PACKAGE_RPI_USERLAND
        depends on BR2_INSTALL_LIBSTDCPP
        depends on BR2_TOOLCHAIN_HAS_THREADS
        depends on BR2_TOOLCHAIN_USES_GLIBC
        help
          The OTTO executable, autostarting on boot
```

## package/otto/Config.in
```kconfig
config BR2_PACKAGE_OTTO
	bool "Otto"
	select BR2_PACKAGE_RPI_FIRMWARE
	help
	  Embedded Raspberry PI 3 Linux distribution for the OTTO

if BR2_PACKAGE_OTTO

config BR2_PACKAGE_OTTO_CONFIG_DTOVERLAY
	string "Device tree overlays"
	help
	  Device tree overlays that will be added to config.xml

config BR2_PACKAGE_OTTO_CONFIG_DTPARAM
	string "Device tree params"
	help
	  Device tree parameters that will be added to config.xml

config BR2_PACKAGE_OTTO_BOOT_SPLASH
	string "Path to ASCII PPM splash image"
	default "package/otto/logo_linux_clut224.ppm"
	help
	  The path towards an ASCII PPM image that will be compiled into the
	  Linux kernel to use as a boot splash screen

endif # BR2_PACKAGE_OTTO
```
